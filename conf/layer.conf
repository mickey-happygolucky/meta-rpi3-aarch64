## conf/layer.conf
```bitbake
# We have a conf and classes directory, append to BBPATH
BBPATH .= ":${LAYERDIR}"

# We have a recipes directory containing .bb and .bbappend files, add to BBFILES
BBFILES += "${LAYERDIR}/recipes*/*/*.bb \
            ${LAYERDIR}/recipes*/*/*.bbappend"

BBFILE_COLLECTIONS += "rpi3-aarch64"
BBFILE_PATTERN_rpi3-aarch64 := "^${LAYERDIR}/"
BBFILE_PRIORITY_rpi3-aarch64 = "10"

LAYERDEPENDS_rpi3-aarch64 = "raspberrypi"
```

## conf/machine/raspberrypi3-64.conf
```bitbake
#@TYPE: Machine
#@NAME: RaspberryPi 3 Development Board
#@DESCRIPTION: Machine configuration for the RaspberryPi 3

MACHINEOVERRIDES = "raspberrypi2:${MACHINE}"

MACHINE_EXTRA_RRECOMMENDS += "linux-firmware-brcm43430"
TARGET_FPU = "hard"

PREFERRED_VERSION_linux-raspberrypi ?= "4.8.%"

SDIMG_KERNELIMAGE_raspberrypi2 ?= "kernel8.img"
KERNEL_DEVICETREE = " \
	broadcom/bcm2710-rpi-3-b.dtb \
    "

TUNE_CCARGS ?= "-mtune=cortex-a53"

require conf/machine/include/arm/arch-armv8.inc
include conf/machine/include/rpi-base.inc
```
